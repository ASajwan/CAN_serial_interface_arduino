VERSION ""

NS_ :

BS_:

BU_:

BO_ 104 MXRPT_Q: 1 Vector__XXX
 SG_ MXRPT_Q : 0|8@1+ (1,0) [50|200] "psig" Vector__XXX

BO_ 103 MXRPT: 1 Vector__XXX
 SG_ MXRPT : 0|8@1+ (1,0) [50|200] "psig" Vector__XXX

BO_ 102 MXFP_Q: 1 Vector__XXX
 SG_ MXFP_Q : 0|8@1+ (1,0) [50|200] "psig" Vector__XXX

BO_ 101 MXFP: 1 Vector__XXX
 SG_ MXFP : 0|8@1+ (1,0) [50|200] "psig" Vector__XXX

CM_ BO_ 104 "This frame is to query the target pressure from the gas mixer.";
CM_ BO_ 103 "This frame is to set the target pressure for the gas mixer.";
CM_ BO_ 102 "This frame is to query the feed pressure from the gas mixer.";
CM_ BO_ 101 "This frame is to set the feed pressure";
BA_DEF_  "BusType" STRING ;
BA_DEF_DEF_  "BusType" "CAN";
