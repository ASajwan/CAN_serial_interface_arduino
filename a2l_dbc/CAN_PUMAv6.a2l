/begin PROJECT CAN_Comm_Trial "CAN communication with PUMA by Ashish Sajwan"
/begin MODULE CAN_PUMA "CAN PUMA"
/begin MOD_COMMON "Module-wide parameters" BYTE_ORDER MSB_LAST /* little endian (Intel) byte order */ /end MOD_COMMON
/begin IF_DATA ASAP1B_CAN TP_BLOB 250 /* 250 kBit/s for this node */ /end IF_DATA
/begin CHARACTERISTIC MXRM_CMD "Mixer Run Mode command from PUMA" VALUE 0 NULL 0.1 CONV_ONE 0.0 3.0 /end CHARACTERISTIC
/begin CHARACTERISTIC MXRPT_CMD "Mixer Target Pressure command from PUMA" VALUE 0 NULL 0.1 CONV_ONE 0.0 3.0 /end CHARACTERISTIC
/begin CHARACTERISTIC MXRFF_CMD "Mixture flow command from PUMA" VALUE 0 NULL 0.1 CONV_ONE 0.0 3.0 /end CHARACTERISTIC
/begin CHARACTERISTIC MXMF_METHANE "Methane Gas mass fraction command from PUMA" VALUE 0 NULL 0.1 CONV_ONE 0.0 3.0 /end CHARACTERISTIC
/begin CHARACTERISTIC MXMF_CNG "CNG mass fraction command from PUMA" VALUE 0 NULL 0.1 CONV_ONE 0.0 3.0 /end CHARACTERISTIC
/begin CHARACTERISTIC MXMF_PROPANE "Propane Gas mass fraction command from PUMA" VALUE 0 NULL 0.1 CONV_ONE 0.0 3.0 /end CHARACTERISTIC
/begin CHARACTERISTIC MXMF_ETHANE "Ethane Gas mass fraction command from PUMA" VALUE 0 NULL 0.1 CONV_ONE 0.0 3.0 /end CHARACTERISTIC
/begin MEASUREMENT GAUGE_PRESSURE "Pressure measurement value from the GasMixer" UWORD CONV_ONE 0 0.0 0.0 3.0
 /begin IF_DATA ASAP1B_CAN
  /begin KP_BLOB "GAUGE_PRESSURE" 0x00000066 1 "GasMixer" 0 8 /end KP_BLOB
 /end IF_DATA
/end MEASUREMENT
/begin MEASUREMENT MASS_FLOW_0 "Mass flow measurement values from the GasMixer" UWORD CONV_ONE 0 0.0 0.0 3.0
 /begin IF_DATA ASAP1B_CAN
  /begin KP_BLOB "MASS_FLOW_0" 0x00000068 2 "GasMixer" 0 16 /end KP_BLOB
 /end IF_DATA
/end MEASUREMENT
/begin MEASUREMENT MASS_FLOW_1 "Mass flow measurement values from the GasMixer" UWORD CONV_ONE 0 0.0 0.0 3.0
 /begin IF_DATA ASAP1B_CAN
  /begin KP_BLOB "MASS_FLOW_1" 0x0000006A 2 "GasMixer" 0 16 /end KP_BLOB
 /end IF_DATA
/end MEASUREMENT
/begin MEASUREMENT MASS_FLOW_2 "Mass flow measurement values from the GasMixer" UWORD CONV_ONE 0 0.0 0.0 3.0
 /begin IF_DATA ASAP1B_CAN
  /begin KP_BLOB "MASS_FLOW_2" 0x0000006C 2 "GasMixer" 0 16 /end KP_BLOB
 /end IF_DATA
/end MEASUREMENT
/begin MEASUREMENT MASS_FLOW_3 "Mass flow measurement values from the GasMixer" UWORD CONV_ONE 0 0.0 0.0 3.0
 /begin IF_DATA ASAP1B_CAN
  /begin KP_BLOB "MASS_FLOW_3" 0x0000006E 2 "GasMixer" 0 16 /end KP_BLOB
 /end IF_DATA
/end MEASUREMENT
/begin MEASUREMENT MASS_FLOW_4 "Mass flow measurement values from the GasMixer" UWORD CONV_ONE 0 0.0 0.0 3.0
 /begin IF_DATA ASAP1B_CAN
  /begin KP_BLOB "MASS_FLOW_4" 0x00000070 2 "GasMixer" 0 16 /end KP_BLOB
 /end IF_DATA
/end MEASUREMENT
/begin MEASUREMENT ERR "Error flag from the GasMixer" UWORD CONV_ONE 0 0.0 0.0 3.0
 /begin IF_DATA ASAP1B_CAN
  /begin KP_BLOB "ERR" 0x00000072 1 "GasMixer" 0 8 /end KP_BLOB
 /end IF_DATA
/end MEASUREMENT
/begin COMPU_METHOD CONV_ONE "Conversion, identity" /* description */ RAT_FUNC /* conversion type */ "%4.2" /* display format, ignored */ "1" /* physical unit, ignored */ COEFFS 0 1 0 0 0 1 /* [a,b,c,d,e,f] in (ax^2+bx+c)/(dx^2+ex+f) */ /end COMPU_METHOD
/end MODULE
/end PROJECT
